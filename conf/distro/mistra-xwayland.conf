## conf/distro/mistra-xwayland.conf
```bitbake
# Mistra Distro for Wayland with XWayland

require conf/distro/include/mistra-base.inc

DISTRO = "mistra-xwayland"
DISTRO_NAME = "Mistra XWayland"

# Define Init System
INIT_MANAGER = "systemd"

# Remove conflicting backends.
DISTRO_FEATURES:remove = "directfb"
DISTRO_FEATURES:append = " x11 wayland pam"
```

## conf/layer.conf
```bitbake
# We have a conf and classes directory, add to BBPATH
BBPATH .= ":${LAYERDIR}"

# We have recipes-* directories, add to BBFILES
BBFILES += " \
	${LAYERDIR}/recipes-*/*/*.bb \
	${LAYERDIR}/recipes-*/*/*.bbappend \
	"

BBFILE_COLLECTIONS += "meta-mistra-base"
BBFILE_PATTERN_meta-mistra-base = "^${LAYERDIR}/"
LAYERDEPENDS_meta-mistra-base = " \
	core \
"

LAYERSERIES_COMPAT_meta-mistra-base = "kirkstone"
```
